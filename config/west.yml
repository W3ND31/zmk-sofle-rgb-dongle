## config/west.yml
```yaml
manifest:
  remotes:
  - name: zmkfirmware
    url-base: https://github.com/zmkfirmware
  - name: mctechnology17
    url-base: https://github.com/mctechnology17
  - name: englmaxi
    url-base: https://github.com/englmaxi
  projects:
  - name: zmk
    remote: zmkfirmware
    revision: v0.3
    import: app/west.yml
  - name: zmk-dongle-display
    remote: englmaxi
    revision: main
  - name: zmk-nice-oled
    remote: mctechnology17
    revision: main
  self:
    path: config
```
